## boards/shields/ctrl/Kconfig.defconfig
```kconfig
if SHIELD_CTRL

config ZMK_KEYBOARD_NAME
    default "CTRL 3x4"

if SHIELD_CTRL_DISPLAY
config DISPLAY
    default y
config ZMK_DISPLAY
    default y
endif

endif
```

## boards/shields/ctrl/Kconfig.shield
```kconfig
config SHIELD_CTRL
    def_bool $(shields_list_contains,ctrl)

if SHIELD_CTRL

config SHIELD_CTRL_DISPLAY
    bool "Enable CTRL display"
    default y

endif
```

## west.yml
```yaml
manifest:
  remotes:
    - name: zephyr-display-nv3030b
      url-base: https://github.com/KONTRBND
  projects:
    - name: zephyr-display-nv3030b
      remote: zephyr-display-nv3030b
      import: west.yml
```
